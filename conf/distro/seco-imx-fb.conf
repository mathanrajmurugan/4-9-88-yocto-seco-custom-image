## conf/distro/seco-imx-fb.conf
```bitbake
# i.MX DISTRO for the FrameBuffer graphical backend.

include conf/distro/include/fsl-imx-base.inc
include conf/distro/include/seco-imx-preferred-env.inc

DISTRO = "seco-imx-fb"

# Remove conflicting backends.
DISTRO_FEATURES_remove = "x11 wayland directfb "

DISTRO_NAME = "SECO/NXP i.MX Release Distro"
```

## conf/layer.conf
```bitbake
# Let bitbake find our .bbclass and .conf files
BBPATH .= ":${LAYERDIR}"

# Let bitbake know where to look for .bb and .bbappend files
BBFILES += "${LAYERDIR}/recipes-*/*/*.bb \
            ${LAYERDIR}/recipes-*/*/*.bbappend"

#BBFILE_COLLECTIONS += "sbca62"
#BBFILE_COLLECTIONS += "seco_928_quad_1gb"

#BBFILE_PATTERN_sbca62 := "^${LAYERDIR}/"
#BBFILE_PRIORITY_sbca62 = "6"

#BBFILE_PATTERN_seco_928_quad_1gb := "^${LAYERDIR}/"
#BBFILE_PRIORITY_seco_928_quad_1gb = "6"

BBFILE_COLLECTIONS +="seco-bsp-release-bsp7"
BBFILE_PATTERN_seco-bsp-release-bsp7 = "^${LAYERDIR}/"
#BBFILE_PRIORITY_seco-bsp-release-bsp7 = "6"

BBMASK += "meta-freescale/dynamic-layers/qt5-layer/recipes-qt/qt5/qtbase_%.bbappend"
BBMASK += "meta-freescale-distro/recipes-fsl/packagegroups/packagegroup-fsl-tools-gpu-external.bb"
BBMASK += "meta-freescale/recipes-graphics/clutter/clutter-1.0_%.bbappend"
BBMASK += "meta-freescale/recipes-graphics/cogl/cogl-1.0_%.bbappend"
BBMASK += "meta-freescale/recipes-graphics/mesa/mesa-demos_%.bbappend"
BBMASK += "meta-freescale/recipes-graphics/xorg-driver/xf86-video-imxfb-vivante_5.0.11.p8.6.bb"

HOSTTOOLS_NONFATAL_append = " sha384sum"


LAYERDEPENDS_seco-bsp-release-bsp7 += "fsl-bsp-release"
LAYERDEPENDS_seco-bsp-release-bsp7 += "fsl-sdk-release"
```

## conf/machine/imx6qdl_uq7_962.conf
```bitbake
#@TYPE: Machine
#@NAME: seco-imx6
#@SOC: i.MX6Q/D/DL/S
#@DESCRIPTION: Machine configuration for SECO-UQ7-962

require conf/machine/include/seco-common.inc


KERNEL_DEVICETREE ?= "imx6q-seco_uq7_962.dtb \
		      imx6dl-seco_uq7_962.dtb"


UBOOT_CONFIG ??= "4x512"
UBOOT_CONFIG[2x256] = "mx6qdl_seco_uQ7_962_512M_2x256M_defconfig"
UBOOT_CONFIG[4x256] = "mx6qdl_seco_uQ7_962_1G_2x512M_defconfig"
UBOOT_CONFIG[4x512] = "mx6qdl_seco_uQ7_962_2G_4x512M_defconfig"

#do_rootfs[depends] += "u-boot-uenv:do_deploy"

#UENV_FILENAME = "uEnv.txt"
#BOOT_SCRIPTS = "${UENV_FILENAME}:uEnv.txt"
```

## conf/machine/include/seco-common.inc
```bitbake
# Provides the i.MX6 SECO common settings


require conf/machine/include/tune-cortexa9.inc
require conf/machine/include/seco-imx-base.inc

SERIAL_CONSOLE = "115200 ttymxc0"


MACHINEOVERRIDES =. "mx6:mx6qdl:"


PREFERRED_PROVIDER_u-boot = "u-boot-seco"
PREFERRED_PROVIDER_u-boot_mx6 = "u-boot-seco"
PREFERRED_PROVIDER_virtual/bootloader = "u-boot-seco"
PREFERRED_PROVIDER_virtual/bootloader_mx6 = "u-boot-seco"

UBOOT_MAKE_TARGET = "spl_imx"
UBOOT_SUFFIX = "imx"
SPL_BINARY = "SPL"


#PREFERRED_PROVIDER_virtual/kernel = "linux-seco"
#PREFERRED_PROVIDER_virtual/kernel_mx6 = "linux-seco"
#PREFERRED_PROVIDER_virtual/kernel_mx6qdl = "linux-seco"


KERNEL_IMAGETYPE = "zImage"


MACHINE_FEATURES += " pci wifi bluetooth usbhost usbgadget screen"
```
